## solarispkn-verity/integrations/yocto/meta-solarispkn-crypto/conf/layer.conf
```bitbake
BBPATH .= ":${LAYERDIR}"
BBFILES += "${LAYERDIR}/recipes-*/*/*.bb ${LAYERDIR}/recipes-*/*/*.bbappend"
BBFILE_COLLECTIONS += "solarispkn-crypto"
BBFILE_PATTERN_solarispkn-crypto = "^${LAYERDIR}/"
BBFILE_PRIORITY_solarispkn-crypto = "8"
LAYERSERIES_COMPAT_solarispkn-crypto = "wrynose"
LAYERDEPENDS_solarispkn-crypto = "core"
```
